#include <behaviors.dtsi>
#include <dt-bindings/zmk/keys.h>
#include <dt-bindings/zmk/bt.h>
#include "keys_nb.h"

/ {
    keymap {
        compatible = "zmk,keymap";

        default_layer {
            bindings = <
                &kp ESC    &kp Q    &kp W   &kp E   &kp R    &kp T    &kp Y    &kp U    &kp I    &kp O    &kp P    &kp NB_A_RING
            >;
        };
    };
};